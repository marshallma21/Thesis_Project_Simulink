VERSION ""

NS_ :

BS_:

BU_:

BO_ 1023 ECU2_01_3FF: 8 Vector__XXX
 SG_ PotValue : 7|8@0+ (1,0) [0|255] "s" Vector__XXX
 SG_ LEDSts : 39|1@0+ (1,0) [0|1] "" Vector__XXX

BO_ 1022 ECU1_01_3FE: 8 Vector__XXX
 SG_ IntReq : 7|8@0+ (1,0) [0|255] "" Vector__XXX

BA_DEF_ SG_  "GenSigSendType" ENUM  "Cyclic","OnWrite","OnWriteWithRepetition","OnChange","OnChangeWithRepetition","IfActive","IfActiveWithRepetition","NoSigSendType";
BA_DEF_ BO_  "GenMsgSendType" ENUM  "Cyclic","not_used","not_used","not_used","not_used","Cyclic","not_used","IfActive","NoMsgSendType";
BA_DEF_  "DBName" STRING ;
BA_DEF_  "BusType" STRING ;
BA_DEF_DEF_  "GenSigSendType" "Cyclic";
BA_DEF_DEF_  "GenMsgSendType" "NoMsgSendType";
BA_DEF_DEF_  "DBName" "";
BA_DEF_DEF_  "BusType" "CAN";
BA_ "DBName" "CAN1";
